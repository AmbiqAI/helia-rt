## CMakeLists.txt
```
# Minimal Zephyr application that links the heliaRT library and calls into
# its public API. Used by the smoke_cmake workflow's zephyr-build job.

cmake_minimum_required(VERSION 3.20.0)

find_package(Zephyr REQUIRED HINTS $ENV{ZEPHYR_BASE})
project(helia_rt_zephyr_smoke LANGUAGES C CXX)

target_sources(app PRIVATE src/main.cc)
```

## prj.conf
```kconfig
# heliaRT Zephyr smoke configuration.
CONFIG_HELIA_RT=y
CONFIG_HELIA_RT_BACKEND_REFERENCE=y

# C++ runtime needed by TFLM / heliaRT. TFLM headers use C++17 (`if constexpr`,
# std::is_integral_v), so request C++17.
CONFIG_CPP=y
CONFIG_STD_CPP17=y
CONFIG_REQUIRES_FULL_LIBCPP=y
CONFIG_PICOLIBC=y
CONFIG_PICOLIBC_USE_MODULE=y

# Reasonable footprint for a qemu_cortex_m3 smoke.
CONFIG_MAIN_STACK_SIZE=4096
CONFIG_HEAP_MEM_POOL_SIZE=8192
```

## src/main.cc
```c
// Minimal heliaRT Zephyr smoke app.
//
// Exercises the public TFLM API surface enough to force the Zephyr module's
// helia_rt library to link in (otherwise `--gc-sections` would drop it and
// the smoke would degenerate into "does Zephyr build?").

#include "tensorflow/lite/micro/micro_log.h"
#include "tensorflow/lite/micro/micro_op_resolver.h"
#include "tensorflow/lite/micro/micro_mutable_op_resolver.h"

namespace {
// Force the linker to keep a non-trivial symbol from each major
// heliaRT translation unit family.
tflite::MicroMutableOpResolver<3> g_resolver;
}  // namespace

int main(void) {
    // Touch a few op registrations so kernel TUs stay in the link graph.
    (void)g_resolver.AddFullyConnected();
    (void)g_resolver.AddSoftmax();
    (void)g_resolver.AddReshape();
    MicroPrintf("heliaRT Zephyr smoke alive: ops=%u",
                static_cast<unsigned>(g_resolver.GetRegistrationLength()));
    return 0;
}
```
