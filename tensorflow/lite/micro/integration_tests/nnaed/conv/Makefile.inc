integration_tests_nnaed_conv_GENERATOR_INPUTS := \
$(TENSORFLOW_ROOT)/home/ns-tflm/tensorflow/lite/micro/integration_tests/nnaed/conv/conv0.tflite \
$(TENSORFLOW_ROOT)/home/ns-tflm/tensorflow/lite/micro/integration_tests/nnaed/conv/conv1.tflite \
$(TENSORFLOW_ROOT)/home/ns-tflm/tensorflow/lite/micro/integration_tests/nnaed/conv/conv2.tflite \
$(TENSORFLOW_ROOT)/home/ns-tflm/tensorflow/lite/micro/integration_tests/nnaed/conv/conv3.tflite \
$(TENSORFLOW_ROOT)/home/ns-tflm/tensorflow/lite/micro/integration_tests/nnaed/conv/conv4.tflite \
$(TENSORFLOW_ROOT)/home/ns-tflm/tensorflow/lite/micro/integration_tests/nnaed/conv/conv5.tflite \
$(TENSORFLOW_ROOT)/home/ns-tflm/tensorflow/lite/micro/integration_tests/nnaed/conv/conv6.tflite \
$(TENSORFLOW_ROOT)/home/ns-tflm/tensorflow/lite/micro/integration_tests/nnaed/conv/conv7.tflite \
$(TENSORFLOW_ROOT)/home/ns-tflm/tensorflow/lite/micro/integration_tests/nnaed/conv/conv8.tflite \
$(TENSORFLOW_ROOT)/home/ns-tflm/tensorflow/lite/micro/integration_tests/nnaed/conv/conv9.tflite \
$(TENSORFLOW_ROOT)/home/ns-tflm/tensorflow/lite/micro/integration_tests/nnaed/conv/conv10.tflite \
$(TENSORFLOW_ROOT)/home/ns-tflm/tensorflow/lite/micro/integration_tests/nnaed/conv/conv11.tflite \
$(TENSORFLOW_ROOT)/home/ns-tflm/tensorflow/lite/micro/integration_tests/nnaed/conv/conv12.tflite \
$(TENSORFLOW_ROOT)/home/ns-tflm/tensorflow/lite/micro/integration_tests/nnaed/conv/conv13.tflite \
$(TENSORFLOW_ROOT)/home/ns-tflm/tensorflow/lite/micro/integration_tests/nnaed/conv/conv14.tflite \
$(TENSORFLOW_ROOT)/home/ns-tflm/tensorflow/lite/micro/integration_tests/nnaed/conv/conv15.tflite \
$(TENSORFLOW_ROOT)/home/ns-tflm/tensorflow/lite/micro/integration_tests/nnaed/conv/conv16.tflite \
$(TENSORFLOW_ROOT)/home/ns-tflm/tensorflow/lite/micro/integration_tests/nnaed/conv/conv17.tflite \
$(TENSORFLOW_ROOT)/home/ns-tflm/tensorflow/lite/micro/integration_tests/nnaed/conv/conv18.tflite \
$(TENSORFLOW_ROOT)/home/ns-tflm/tensorflow/lite/micro/integration_tests/nnaed/conv/conv19.tflite \
$(TENSORFLOW_ROOT)/home/ns-tflm/tensorflow/lite/micro/integration_tests/nnaed/conv/conv20.tflite \
$(TENSORFLOW_ROOT)/home/ns-tflm/tensorflow/lite/micro/integration_tests/nnaed/conv/conv21.tflite \
$(TENSORFLOW_ROOT)/home/ns-tflm/tensorflow/lite/micro/integration_tests/nnaed/conv/conv22.tflite \
$(TENSORFLOW_ROOT)/home/ns-tflm/tensorflow/lite/micro/integration_tests/nnaed/conv/conv23.tflite \
$(TENSORFLOW_ROOT)/home/ns-tflm/tensorflow/lite/micro/integration_tests/nnaed/conv/conv24.tflite \
$(TENSORFLOW_ROOT)/home/ns-tflm/tensorflow/lite/micro/integration_tests/nnaed/conv/conv25.tflite \
$(TENSORFLOW_ROOT)/home/ns-tflm/tensorflow/lite/micro/integration_tests/nnaed/conv/conv26.tflite \
$(TENSORFLOW_ROOT)/home/ns-tflm/tensorflow/lite/micro/integration_tests/nnaed/conv/conv0_input0_int8.csv \
$(TENSORFLOW_ROOT)/home/ns-tflm/tensorflow/lite/micro/integration_tests/nnaed/conv/conv0_golden_int8.csv \
$(TENSORFLOW_ROOT)/home/ns-tflm/tensorflow/lite/micro/integration_tests/nnaed/conv/conv1_input0_int8.csv \
$(TENSORFLOW_ROOT)/home/ns-tflm/tensorflow/lite/micro/integration_tests/nnaed/conv/conv1_golden_int8.csv \
$(TENSORFLOW_ROOT)/home/ns-tflm/tensorflow/lite/micro/integration_tests/nnaed/conv/conv2_input0_int8.csv \
$(TENSORFLOW_ROOT)/home/ns-tflm/tensorflow/lite/micro/integration_tests/nnaed/conv/conv2_golden_int8.csv \
$(TENSORFLOW_ROOT)/home/ns-tflm/tensorflow/lite/micro/integration_tests/nnaed/conv/conv3_input0_int8.csv \
$(TENSORFLOW_ROOT)/home/ns-tflm/tensorflow/lite/micro/integration_tests/nnaed/conv/conv3_golden_int8.csv \
$(TENSORFLOW_ROOT)/home/ns-tflm/tensorflow/lite/micro/integration_tests/nnaed/conv/conv4_input0_int8.csv \
$(TENSORFLOW_ROOT)/home/ns-tflm/tensorflow/lite/micro/integration_tests/nnaed/conv/conv4_golden_int8.csv \
$(TENSORFLOW_ROOT)/home/ns-tflm/tensorflow/lite/micro/integration_tests/nnaed/conv/conv5_input0_int8.csv \
$(TENSORFLOW_ROOT)/home/ns-tflm/tensorflow/lite/micro/integration_tests/nnaed/conv/conv5_golden_int8.csv \
$(TENSORFLOW_ROOT)/home/ns-tflm/tensorflow/lite/micro/integration_tests/nnaed/conv/conv6_input0_int8.csv \
$(TENSORFLOW_ROOT)/home/ns-tflm/tensorflow/lite/micro/integration_tests/nnaed/conv/conv6_golden_int8.csv \
$(TENSORFLOW_ROOT)/home/ns-tflm/tensorflow/lite/micro/integration_tests/nnaed/conv/conv7_input0_int8.csv \
$(TENSORFLOW_ROOT)/home/ns-tflm/tensorflow/lite/micro/integration_tests/nnaed/conv/conv7_golden_int8.csv \
$(TENSORFLOW_ROOT)/home/ns-tflm/tensorflow/lite/micro/integration_tests/nnaed/conv/conv8_input0_int8.csv \
$(TENSORFLOW_ROOT)/home/ns-tflm/tensorflow/lite/micro/integration_tests/nnaed/conv/conv8_golden_int8.csv \
$(TENSORFLOW_ROOT)/home/ns-tflm/tensorflow/lite/micro/integration_tests/nnaed/conv/conv9_input0_int8.csv \
$(TENSORFLOW_ROOT)/home/ns-tflm/tensorflow/lite/micro/integration_tests/nnaed/conv/conv9_golden_int8.csv \
$(TENSORFLOW_ROOT)/home/ns-tflm/tensorflow/lite/micro/integration_tests/nnaed/conv/conv10_input0_int8.csv \
$(TENSORFLOW_ROOT)/home/ns-tflm/tensorflow/lite/micro/integration_tests/nnaed/conv/conv10_golden_int8.csv \
$(TENSORFLOW_ROOT)/home/ns-tflm/tensorflow/lite/micro/integration_tests/nnaed/conv/conv11_input0_int8.csv \
$(TENSORFLOW_ROOT)/home/ns-tflm/tensorflow/lite/micro/integration_tests/nnaed/conv/conv11_golden_int8.csv \
$(TENSORFLOW_ROOT)/home/ns-tflm/tensorflow/lite/micro/integration_tests/nnaed/conv/conv12_input0_int8.csv \
$(TENSORFLOW_ROOT)/home/ns-tflm/tensorflow/lite/micro/integration_tests/nnaed/conv/conv12_golden_int8.csv \
$(TENSORFLOW_ROOT)/home/ns-tflm/tensorflow/lite/micro/integration_tests/nnaed/conv/conv13_input0_int8.csv \
$(TENSORFLOW_ROOT)/home/ns-tflm/tensorflow/lite/micro/integration_tests/nnaed/conv/conv13_golden_int8.csv \
$(TENSORFLOW_ROOT)/home/ns-tflm/tensorflow/lite/micro/integration_tests/nnaed/conv/conv14_input0_int8.csv \
$(TENSORFLOW_ROOT)/home/ns-tflm/tensorflow/lite/micro/integration_tests/nnaed/conv/conv14_golden_int8.csv \
$(TENSORFLOW_ROOT)/home/ns-tflm/tensorflow/lite/micro/integration_tests/nnaed/conv/conv15_input0_int8.csv \
$(TENSORFLOW_ROOT)/home/ns-tflm/tensorflow/lite/micro/integration_tests/nnaed/conv/conv15_golden_int8.csv \
$(TENSORFLOW_ROOT)/home/ns-tflm/tensorflow/lite/micro/integration_tests/nnaed/conv/conv16_input0_int8.csv \
$(TENSORFLOW_ROOT)/home/ns-tflm/tensorflow/lite/micro/integration_tests/nnaed/conv/conv16_golden_int8.csv \
$(TENSORFLOW_ROOT)/home/ns-tflm/tensorflow/lite/micro/integration_tests/nnaed/conv/conv17_input0_int8.csv \
$(TENSORFLOW_ROOT)/home/ns-tflm/tensorflow/lite/micro/integration_tests/nnaed/conv/conv17_golden_int8.csv \
$(TENSORFLOW_ROOT)/home/ns-tflm/tensorflow/lite/micro/integration_tests/nnaed/conv/conv18_input0_int8.csv \
$(TENSORFLOW_ROOT)/home/ns-tflm/tensorflow/lite/micro/integration_tests/nnaed/conv/conv18_golden_int8.csv \
$(TENSORFLOW_ROOT)/home/ns-tflm/tensorflow/lite/micro/integration_tests/nnaed/conv/conv19_input0_int8.csv \
$(TENSORFLOW_ROOT)/home/ns-tflm/tensorflow/lite/micro/integration_tests/nnaed/conv/conv19_golden_int8.csv \
$(TENSORFLOW_ROOT)/home/ns-tflm/tensorflow/lite/micro/integration_tests/nnaed/conv/conv20_input0_int8.csv \
$(TENSORFLOW_ROOT)/home/ns-tflm/tensorflow/lite/micro/integration_tests/nnaed/conv/conv20_golden_int8.csv \
$(TENSORFLOW_ROOT)/home/ns-tflm/tensorflow/lite/micro/integration_tests/nnaed/conv/conv21_input0_int8.csv \
$(TENSORFLOW_ROOT)/home/ns-tflm/tensorflow/lite/micro/integration_tests/nnaed/conv/conv21_golden_int8.csv \
$(TENSORFLOW_ROOT)/home/ns-tflm/tensorflow/lite/micro/integration_tests/nnaed/conv/conv22_input0_int8.csv \
$(TENSORFLOW_ROOT)/home/ns-tflm/tensorflow/lite/micro/integration_tests/nnaed/conv/conv22_golden_int8.csv \
$(TENSORFLOW_ROOT)/home/ns-tflm/tensorflow/lite/micro/integration_tests/nnaed/conv/conv23_input0_int8.csv \
$(TENSORFLOW_ROOT)/home/ns-tflm/tensorflow/lite/micro/integration_tests/nnaed/conv/conv23_golden_int8.csv \
$(TENSORFLOW_ROOT)/home/ns-tflm/tensorflow/lite/micro/integration_tests/nnaed/conv/conv24_input0_int8.csv \
$(TENSORFLOW_ROOT)/home/ns-tflm/tensorflow/lite/micro/integration_tests/nnaed/conv/conv24_golden_int8.csv \
$(TENSORFLOW_ROOT)/home/ns-tflm/tensorflow/lite/micro/integration_tests/nnaed/conv/conv25_input0_int8.csv \
$(TENSORFLOW_ROOT)/home/ns-tflm/tensorflow/lite/micro/integration_tests/nnaed/conv/conv25_golden_int8.csv \
$(TENSORFLOW_ROOT)/home/ns-tflm/tensorflow/lite/micro/integration_tests/nnaed/conv/conv26_input0_int8.csv \
$(TENSORFLOW_ROOT)/home/ns-tflm/tensorflow/lite/micro/integration_tests/nnaed/conv/conv26_golden_int8.csv \

integration_tests_nnaed_conv_SRCS := \
$(TENSORFLOW_ROOT)/home/ns-tflm/tensorflow/lite/micro/integration_tests/nnaed/conv/integration_tests.cc  \
$(TENSORFLOW_ROOT)python/tflite_micro/python_ops_resolver.cc \


integration_tests_nnaed_conv_HDR := \
$(TENSORFLOW_ROOT)python/tflite_micro/python_ops_resolver.h \


$(eval $(call microlite_test,integration_tests_nnaed_conv_test,\
$(integration_tests_nnaed_conv_SRCS),$(integration_tests_nnaed_conv_HDR),$(integration_tests_nnaed_conv_GENERATOR_INPUTS)))