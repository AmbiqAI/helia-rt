integration_tests_nnaed_pad_GENERATOR_INPUTS := \
$(TENSORFLOW_ROOT)/home/ns-tflm/tensorflow/lite/micro/integration_tests/nnaed/pad/pad0.tflite \
$(TENSORFLOW_ROOT)/home/ns-tflm/tensorflow/lite/micro/integration_tests/nnaed/pad/pad1.tflite \
$(TENSORFLOW_ROOT)/home/ns-tflm/tensorflow/lite/micro/integration_tests/nnaed/pad/pad2.tflite \
$(TENSORFLOW_ROOT)/home/ns-tflm/tensorflow/lite/micro/integration_tests/nnaed/pad/pad3.tflite \
$(TENSORFLOW_ROOT)/home/ns-tflm/tensorflow/lite/micro/integration_tests/nnaed/pad/pad4.tflite \
$(TENSORFLOW_ROOT)/home/ns-tflm/tensorflow/lite/micro/integration_tests/nnaed/pad/pad5.tflite \
$(TENSORFLOW_ROOT)/home/ns-tflm/tensorflow/lite/micro/integration_tests/nnaed/pad/pad6.tflite \
$(TENSORFLOW_ROOT)/home/ns-tflm/tensorflow/lite/micro/integration_tests/nnaed/pad/pad7.tflite \
$(TENSORFLOW_ROOT)/home/ns-tflm/tensorflow/lite/micro/integration_tests/nnaed/pad/pad8.tflite \
$(TENSORFLOW_ROOT)/home/ns-tflm/tensorflow/lite/micro/integration_tests/nnaed/pad/pad9.tflite \
$(TENSORFLOW_ROOT)/home/ns-tflm/tensorflow/lite/micro/integration_tests/nnaed/pad/pad10.tflite \
$(TENSORFLOW_ROOT)/home/ns-tflm/tensorflow/lite/micro/integration_tests/nnaed/pad/pad11.tflite \
$(TENSORFLOW_ROOT)/home/ns-tflm/tensorflow/lite/micro/integration_tests/nnaed/pad/pad12.tflite \
$(TENSORFLOW_ROOT)/home/ns-tflm/tensorflow/lite/micro/integration_tests/nnaed/pad/pad13.tflite \
$(TENSORFLOW_ROOT)/home/ns-tflm/tensorflow/lite/micro/integration_tests/nnaed/pad/pad14.tflite \
$(TENSORFLOW_ROOT)/home/ns-tflm/tensorflow/lite/micro/integration_tests/nnaed/pad/pad15.tflite \
$(TENSORFLOW_ROOT)/home/ns-tflm/tensorflow/lite/micro/integration_tests/nnaed/pad/pad16.tflite \
$(TENSORFLOW_ROOT)/home/ns-tflm/tensorflow/lite/micro/integration_tests/nnaed/pad/pad17.tflite \
$(TENSORFLOW_ROOT)/home/ns-tflm/tensorflow/lite/micro/integration_tests/nnaed/pad/pad18.tflite \
$(TENSORFLOW_ROOT)/home/ns-tflm/tensorflow/lite/micro/integration_tests/nnaed/pad/pad19.tflite \
$(TENSORFLOW_ROOT)/home/ns-tflm/tensorflow/lite/micro/integration_tests/nnaed/pad/pad20.tflite \
$(TENSORFLOW_ROOT)/home/ns-tflm/tensorflow/lite/micro/integration_tests/nnaed/pad/pad21.tflite \
$(TENSORFLOW_ROOT)/home/ns-tflm/tensorflow/lite/micro/integration_tests/nnaed/pad/pad22.tflite \
$(TENSORFLOW_ROOT)/home/ns-tflm/tensorflow/lite/micro/integration_tests/nnaed/pad/pad23.tflite \
$(TENSORFLOW_ROOT)/home/ns-tflm/tensorflow/lite/micro/integration_tests/nnaed/pad/pad24.tflite \
$(TENSORFLOW_ROOT)/home/ns-tflm/tensorflow/lite/micro/integration_tests/nnaed/pad/pad25.tflite \
$(TENSORFLOW_ROOT)/home/ns-tflm/tensorflow/lite/micro/integration_tests/nnaed/pad/pad0_input0_int8.csv \
$(TENSORFLOW_ROOT)/home/ns-tflm/tensorflow/lite/micro/integration_tests/nnaed/pad/pad0_golden_int8.csv \
$(TENSORFLOW_ROOT)/home/ns-tflm/tensorflow/lite/micro/integration_tests/nnaed/pad/pad1_input0_int8.csv \
$(TENSORFLOW_ROOT)/home/ns-tflm/tensorflow/lite/micro/integration_tests/nnaed/pad/pad1_golden_int8.csv \
$(TENSORFLOW_ROOT)/home/ns-tflm/tensorflow/lite/micro/integration_tests/nnaed/pad/pad2_input0_int8.csv \
$(TENSORFLOW_ROOT)/home/ns-tflm/tensorflow/lite/micro/integration_tests/nnaed/pad/pad2_golden_int8.csv \
$(TENSORFLOW_ROOT)/home/ns-tflm/tensorflow/lite/micro/integration_tests/nnaed/pad/pad3_input0_int8.csv \
$(TENSORFLOW_ROOT)/home/ns-tflm/tensorflow/lite/micro/integration_tests/nnaed/pad/pad3_golden_int8.csv \
$(TENSORFLOW_ROOT)/home/ns-tflm/tensorflow/lite/micro/integration_tests/nnaed/pad/pad4_input0_int8.csv \
$(TENSORFLOW_ROOT)/home/ns-tflm/tensorflow/lite/micro/integration_tests/nnaed/pad/pad4_golden_int8.csv \
$(TENSORFLOW_ROOT)/home/ns-tflm/tensorflow/lite/micro/integration_tests/nnaed/pad/pad5_input0_int8.csv \
$(TENSORFLOW_ROOT)/home/ns-tflm/tensorflow/lite/micro/integration_tests/nnaed/pad/pad5_golden_int8.csv \
$(TENSORFLOW_ROOT)/home/ns-tflm/tensorflow/lite/micro/integration_tests/nnaed/pad/pad6_input0_int8.csv \
$(TENSORFLOW_ROOT)/home/ns-tflm/tensorflow/lite/micro/integration_tests/nnaed/pad/pad6_golden_int8.csv \
$(TENSORFLOW_ROOT)/home/ns-tflm/tensorflow/lite/micro/integration_tests/nnaed/pad/pad7_input0_int8.csv \
$(TENSORFLOW_ROOT)/home/ns-tflm/tensorflow/lite/micro/integration_tests/nnaed/pad/pad7_golden_int8.csv \
$(TENSORFLOW_ROOT)/home/ns-tflm/tensorflow/lite/micro/integration_tests/nnaed/pad/pad8_input0_int8.csv \
$(TENSORFLOW_ROOT)/home/ns-tflm/tensorflow/lite/micro/integration_tests/nnaed/pad/pad8_golden_int8.csv \
$(TENSORFLOW_ROOT)/home/ns-tflm/tensorflow/lite/micro/integration_tests/nnaed/pad/pad9_input0_int8.csv \
$(TENSORFLOW_ROOT)/home/ns-tflm/tensorflow/lite/micro/integration_tests/nnaed/pad/pad9_golden_int8.csv \
$(TENSORFLOW_ROOT)/home/ns-tflm/tensorflow/lite/micro/integration_tests/nnaed/pad/pad10_input0_int8.csv \
$(TENSORFLOW_ROOT)/home/ns-tflm/tensorflow/lite/micro/integration_tests/nnaed/pad/pad10_golden_int8.csv \
$(TENSORFLOW_ROOT)/home/ns-tflm/tensorflow/lite/micro/integration_tests/nnaed/pad/pad11_input0_int8.csv \
$(TENSORFLOW_ROOT)/home/ns-tflm/tensorflow/lite/micro/integration_tests/nnaed/pad/pad11_golden_int8.csv \
$(TENSORFLOW_ROOT)/home/ns-tflm/tensorflow/lite/micro/integration_tests/nnaed/pad/pad12_input0_int8.csv \
$(TENSORFLOW_ROOT)/home/ns-tflm/tensorflow/lite/micro/integration_tests/nnaed/pad/pad12_golden_int8.csv \
$(TENSORFLOW_ROOT)/home/ns-tflm/tensorflow/lite/micro/integration_tests/nnaed/pad/pad13_input0_int8.csv \
$(TENSORFLOW_ROOT)/home/ns-tflm/tensorflow/lite/micro/integration_tests/nnaed/pad/pad13_golden_int8.csv \
$(TENSORFLOW_ROOT)/home/ns-tflm/tensorflow/lite/micro/integration_tests/nnaed/pad/pad14_input0_int8.csv \
$(TENSORFLOW_ROOT)/home/ns-tflm/tensorflow/lite/micro/integration_tests/nnaed/pad/pad14_golden_int8.csv \
$(TENSORFLOW_ROOT)/home/ns-tflm/tensorflow/lite/micro/integration_tests/nnaed/pad/pad15_input0_int8.csv \
$(TENSORFLOW_ROOT)/home/ns-tflm/tensorflow/lite/micro/integration_tests/nnaed/pad/pad15_golden_int8.csv \
$(TENSORFLOW_ROOT)/home/ns-tflm/tensorflow/lite/micro/integration_tests/nnaed/pad/pad16_input0_int8.csv \
$(TENSORFLOW_ROOT)/home/ns-tflm/tensorflow/lite/micro/integration_tests/nnaed/pad/pad16_golden_int8.csv \
$(TENSORFLOW_ROOT)/home/ns-tflm/tensorflow/lite/micro/integration_tests/nnaed/pad/pad17_input0_int8.csv \
$(TENSORFLOW_ROOT)/home/ns-tflm/tensorflow/lite/micro/integration_tests/nnaed/pad/pad17_golden_int8.csv \
$(TENSORFLOW_ROOT)/home/ns-tflm/tensorflow/lite/micro/integration_tests/nnaed/pad/pad18_input0_int8.csv \
$(TENSORFLOW_ROOT)/home/ns-tflm/tensorflow/lite/micro/integration_tests/nnaed/pad/pad18_golden_int8.csv \
$(TENSORFLOW_ROOT)/home/ns-tflm/tensorflow/lite/micro/integration_tests/nnaed/pad/pad19_input0_int8.csv \
$(TENSORFLOW_ROOT)/home/ns-tflm/tensorflow/lite/micro/integration_tests/nnaed/pad/pad19_golden_int8.csv \
$(TENSORFLOW_ROOT)/home/ns-tflm/tensorflow/lite/micro/integration_tests/nnaed/pad/pad20_input0_int8.csv \
$(TENSORFLOW_ROOT)/home/ns-tflm/tensorflow/lite/micro/integration_tests/nnaed/pad/pad20_golden_int8.csv \
$(TENSORFLOW_ROOT)/home/ns-tflm/tensorflow/lite/micro/integration_tests/nnaed/pad/pad21_input0_int8.csv \
$(TENSORFLOW_ROOT)/home/ns-tflm/tensorflow/lite/micro/integration_tests/nnaed/pad/pad21_golden_int8.csv \
$(TENSORFLOW_ROOT)/home/ns-tflm/tensorflow/lite/micro/integration_tests/nnaed/pad/pad22_input0_int8.csv \
$(TENSORFLOW_ROOT)/home/ns-tflm/tensorflow/lite/micro/integration_tests/nnaed/pad/pad22_golden_int8.csv \
$(TENSORFLOW_ROOT)/home/ns-tflm/tensorflow/lite/micro/integration_tests/nnaed/pad/pad23_input0_int8.csv \
$(TENSORFLOW_ROOT)/home/ns-tflm/tensorflow/lite/micro/integration_tests/nnaed/pad/pad23_golden_int8.csv \
$(TENSORFLOW_ROOT)/home/ns-tflm/tensorflow/lite/micro/integration_tests/nnaed/pad/pad24_input0_int8.csv \
$(TENSORFLOW_ROOT)/home/ns-tflm/tensorflow/lite/micro/integration_tests/nnaed/pad/pad24_golden_int8.csv \
$(TENSORFLOW_ROOT)/home/ns-tflm/tensorflow/lite/micro/integration_tests/nnaed/pad/pad25_input0_int8.csv \
$(TENSORFLOW_ROOT)/home/ns-tflm/tensorflow/lite/micro/integration_tests/nnaed/pad/pad25_golden_int8.csv \

integration_tests_nnaed_pad_SRCS := \
$(TENSORFLOW_ROOT)/home/ns-tflm/tensorflow/lite/micro/integration_tests/nnaed/pad/integration_tests.cc  \
$(TENSORFLOW_ROOT)python/tflite_micro/python_ops_resolver.cc \


integration_tests_nnaed_pad_HDR := \
$(TENSORFLOW_ROOT)python/tflite_micro/python_ops_resolver.h \


$(eval $(call microlite_test,integration_tests_nnaed_pad_test,\
$(integration_tests_nnaed_pad_SRCS),$(integration_tests_nnaed_pad_HDR),$(integration_tests_nnaed_pad_GENERATOR_INPUTS)))