## tensorflow/lite/micro/tools/ci_build/templates/zephyr_prebuilt/zephyr/Kconfig
```kconfig
config ZEPHYR_HELIA_RT_MODULE
	bool

menuconfig HELIA_RT
	bool "Helia RT (prebuilt Ambiq optimized TFLM)"
	select REQUIRES_FULL_LIBCPP
	help
		This option enables the prebuilt heliaRT Zephyr module.

if HELIA_RT

choice HELIA_RT_PREBUILT_BUILD_FLAVOR
	prompt "Helia RT prebuilt flavor"
	default HELIA_RT_PREBUILT_BUILD_RELEASE
	help
		Select the prebuilt archive flavor to link against.

config HELIA_RT_PREBUILT_BUILD_DEBUG
	bool "Debug"

config HELIA_RT_PREBUILT_BUILD_RELEASE
	bool "Release"

config HELIA_RT_PREBUILT_BUILD_RELEASE_WITH_LOGS
	bool "Release with logs"

endchoice

endif # HELIA_RT
```

## zephyr/Kconfig
```kconfig
config ZEPHYR_HELIA_RT_MODULE
	bool

menuconfig HELIA_RT
	bool "Helia RT (Ambiq optimized TFLM)"
	select CPP
	select REQUIRES_FULL_LIBCPP
	imply FPU if CPU_HAS_FPU
	imply NS_CMSIS_NN if SOC_FAMILY_AMBIQ
	help
		This option enables heliaRT.

if HELIA_RT

choice HELIA_RT_KERNEL_BACKEND
	prompt "Helia RT kernel backend"
	default HELIA_RT_BACKEND_HELIA if SOC_FAMILY_AMBIQ && NS_CMSIS_NN
	default HELIA_RT_BACKEND_CMSIS_NN if SOC_FAMILY_AMBIQ && CMSIS_NN
	default HELIA_RT_BACKEND_REFERENCE
	help
		Reference works on any architecture. CMSIS-NN uses the open-source
		Arm CMSIS-NN backend. HELIA uses Ambiq's ns-cmsis-nn acceleration
		module.

config HELIA_RT_BACKEND_REFERENCE
	bool "Reference (generic TFLM kernels)"

config HELIA_RT_BACKEND_CMSIS_NN
	bool "CMSIS-NN (open-source Arm optimized kernels)"
	depends on CPU_CORTEX_M && CMSIS_NN
	help
		Uses the open-source Arm CMSIS-NN backend through a separate
		CMSIS-NN Zephyr module.

config HELIA_RT_BACKEND_HELIA
	bool "HELIA (Ambiq optimized kernels)"
	depends on SOC_FAMILY_AMBIQ && NS_CMSIS_NN
	imply NS_CMSIS_NN_ALL
	help
		Uses Ambiq's HELIA acceleration module. This is currently
		distributed as ns-cmsis-nn.

endchoice

choice HELIA_RT_KERNEL_OPTIMIZE
	prompt "Helia RT kernel optimization target"
	depends on HELIA_RT_BACKEND_HELIA
	default HELIA_RT_KERNEL_OPTIMIZE_SPEED
	help
		Selects whether HELIA kernels are tuned for speed or code size.
		Maps to the HELIA_RT_GLOBAL_KERNEL_OPTIMIZE cache variable
		consumed by cmake/helia_rt_sources.cmake (which in turn drives
		CONV_KERNEL_OPTIMIZED_FOR_*, FC_KERNEL_OPTIMIZED_FOR_*, and
		KERNELS_OPTIMIZED_FOR_* compile defines). SPEED matches the
		Makefile/prebuilt default; SIZE trades runtime for smaller code.

config HELIA_RT_KERNEL_OPTIMIZE_SPEED
	bool "Speed"

config HELIA_RT_KERNEL_OPTIMIZE_SIZE
	bool "Size"

endchoice

config HELIA_RT_ENABLE_RECORDING
	bool "Enable recording allocator support"
	help
		Compile RecordingMicroAllocator and the recording single-arena
		buffer allocator into the Zephyr heliaRT module. This is only
		needed for RecordingMicroInterpreter-style arena usage auditing.

config HELIA_RT_ENABLE_TEST_HELPERS
	bool "Enable test and mock helper sources"
	help
		Compile test_helpers, test_helper_custom_ops, mock_micro_graph,
		and fake_micro_context into the Zephyr heliaRT module. These are
		intended for unit tests and KernelRunner-based harnesses, not
		for production inference builds.

endif # HELIA_RT
```
